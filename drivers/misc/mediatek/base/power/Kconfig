## drivers/misc/mediatek/base/power/Kconfig
```kconfig
config MTK_CPU_FREQ
	bool "MTK CPU FREQ"
	help
	  This kernel config can be used to enable CPU FREQ.
	  When enable this option, CPU frequency and voltage will be
	  changed which will depended on CPU FREQ governor.
	  If unsure, say N.

config MTK_CPU_OC_2800
	bool "MT6877 A78 2.8GHz overclock"
	depends on MTK_CPU_FREQ && MACH_MT6877
	default n
	help
	  Replace the top FY-segment Cortex-A78 OPP (2.6GHz) with 2.8GHz.
	  This exceeds the vendor sign-off table and is experimental.

config MTK_CPU_OC_3000
	bool "MT6877 A78 3.0GHz overclock"
	depends on MTK_CPU_FREQ && MACH_MT6877 && MTK_CPU_OC_2800
	default n
	help
	  Replace the top two FY-segment Cortex-A78 OPPs with 3.0GHz and
	  2.8GHz. Voltage headroom is very small; experimental only.

config MTK_CPU_OC_FULL
	bool "MT6877 full 18-step CPU OC table"
	depends on MTK_CPU_FREQ && MACH_MT6877
	default n
	help
	  Insert 3.0GHz/2.8GHz on top of the original 16 FY-segment
	  Cortex-A78 OPP steps and 2.2GHz/2.1GHz on top of the original
	  16 Cortex-A55 steps, preserving all original frequencies.
	  Experimental only.

config MTK_PTPOD
	bool "MTK PTPOD"
	help
	  This kernel config can be used to enable PTPOD.
	  When enable this option, voltage will be
	  changed which will depended on chip.
	  If unsure, say N.

config MTK_PTPOD_GPU
	bool "MTK PTPOD GPU"
	default n
	help
	  This kernel config can be used to enable gpu PTPOD.
	  When enable this option, gpu voltage will be
	  changed which will depended on chip.
	  If unsure, say N.

config MTK_CPU_MSSV
        bool "MTK CPU MSSV SUPPORT"
        help
          This kernel config can be used to enable cpu MSSV support.
          MSSV means Mediatek Software System Validation.
          When enable this option, cpu V/F get/set function will be enabled.
          This config should be enabled with corresponding MCUPM setting.
          If unsure, say N.

config MTK_CPU_KORO
	bool "MTK CPU KORO SUPPORT"
	---help---
	  This kernel config can be used to enable cpu KORO support.
	  When enable this option, system will keep cpus power on while reset.
	  This config should be enabled depend on platform.
	  If unsure, say N.

config MTK_STATIC_POWER
	bool "MTK STATIC POWER"
	help
	  This kernel config can be used to enable static power.
	  This information can provide power data to someone who
	  need it
	  If unsure, say N.

config MTK_UNIFY_POWER
	bool "MTK UNIFY POWER"
	help
	  This kernel config can be used to enable unified power table.
	  This table can provide power data and capacity to someone who
	  need it.
	  If unsure, say Y.

config CPU_FORCE_TO_BIN2
	bool "Read extra efuse for BIN2 IC"
	help
	  This kernel config can be used to force cpu to segment BIN2.
	  When enable this option, eem driver will read extra efuse to
	  obtain parameters for segment BIN2 IC.
	  If unsure, say N.

config MTK_LP_OPP
	bool "MTK LP OPP"
	help
	  This kernel config can be used to enable MTK LP OPP.
	  When enable this option,
	  cpudvfs opp will be changed for low power.
	  If unsure, say N.

config MTK_SWPM
	bool "MTK SW Power Meter"
	help
	  This kernel config can be used to enable SW power meter. When enable
	  this option, user can turn on SW power meter and get average power
	  for each power rail for low power debugging.
	  If unsure, say N.

config MTK_PBM
	bool "MTK power budget management"
	help
	  This kernel config can be used to enable power budget management.
	  When enable this option, pbm will allocate limit power budget to
	  CPU and GPU when battery voltage is low.

config MTK_QOS_FRAMEWORK
	bool "MTK QOS FRAMEWORK"
	help
	  This kernel config can be used to enable MTK QOS FRAMEWORK.
	  When enabling this option, BW Limiter and BW Bound Detector
	  will be enabled and set EMI hardware.
	  If unsure, say N.

config MTK_QOS_V1
	bool "MTK QOS Framework Ver 1.0"
	default y if MACH_MT6768
	help
	  This version support QOS ver 1.0 feature sets.
	  The dram opp could be controlled by the BW prediction.
	  It is also mapped with sspm qos v1.
	  If unsure, say N.

config MTK_QOS_V2
	bool "MTK QOS Framework Ver 2.0"
	default y if MACH_MT6785
	default y if MACH_MT6885
	default y if MACH_MT6873
	default y if MACH_MT6853
	default y if MACH_MT6833
	default y if MACH_MT6877
	default y if MACH_MT6781
	default y if MACH_MT6893
	select MTK_QOS_FRAMEWORK
	help
	  This version support QOS version 2.0 feature sets.
	  It supports BW prediction, BW bound detection, and BW limiter.
	  It is also mapped with sspm qos v2.
	  If unsure, say N.
```
